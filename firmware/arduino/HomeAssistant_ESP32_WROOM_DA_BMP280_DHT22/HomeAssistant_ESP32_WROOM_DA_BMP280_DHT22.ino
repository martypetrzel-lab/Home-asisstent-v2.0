/* ESP32-WROOM-DA: indoor BMP280 SDA21/SCL22; outdoor DHT22 DATA32.
Relays: 26/33 active LOW. INA219 shares the BMP280 bus. Pressure is station pressure, hPa.
Select ESP32-WROOM-DA Module, 4MB, PSRAM disabled, OTA partition.
*/
/*
  HOME ASSISTANT ESP32 - PRIMO NA TABLETU, JEDEN SOUBOR
  Web je ulozen v ESP32. Na tabletu otevrete http://IP-ESP32/.
  Pocitac ani samostatny webovy server nejsou pro provoz potreba.
  Rele 1 GPIO26: svetlo pod troubou; rele 2 GPIO33: volne.
  ACTIVE LOW, pri startu vypnute. Bez garaze. Railway + plny lokalni panel.
  BMP280 uvnitr SDA21/SCL22; DHT22 venku DATA32; INA219 SDA21/SCL22.
  Panel se otevre rovnou bez prihlasovaciho hesla.
  Wi-Fi, API a OTA pristupy jsou take primo v tomto souboru.
  Knihovny: ArduinoJson 7.4.3, DHT sensor library 1.4.7, Adafruit BMP280 Library 2.6.8,
  Adafruit Unified Sensor 1.1.15, INA219 1.2.3, BusIO 1.17.4.
  ESP32-WROOM-DA Module, core Espressif 3.3.8, 4 MB, OTA oddily.
  Zadny dalsi soubor .h/.cpp/HTML pro nahrani neni potreba.
  Cloud pouziva overene HTTPS; lokalni panel zustava dostupny bez internetu.
*/

#include <Arduino.h>
#include <HTTPClient.h>
#include <WiFiClientSecure.h>
#include <cstdint>
#include <cmath>
#include <limits>
#include <ArduinoJson.h>
#include <esp_timer.h>
#include <cctype>
#include <cstring>
#include <WebServer.h>
#include <LittleFS.h>
#include <Preferences.h>
#include <esp_task_wdt.h>
#include <Adafruit_INA219.h>
#include <DHT.h>
#include <Adafruit_BMP280.h>
#include <Wire.h>
#include <ArduinoOTA.h>
#include <ESPmDNS.h>
#include <WiFi.h>
#include <esp_system.h>
#include <esp_arduino_version.h>

// ==================== secrets.h ====================
// Private local configuration. Do not publish.
#define HOME_WIFI_SSID ""
#define HOME_WIFI_PASSWORD ""
#define HOME_API_TOKEN ""
#define HOME_OTA_PASSWORD ""
#define HOME_ALLOWED_ORIGIN ""
#define HOME_OTA_ENABLED true


// Railway nastavení. Token musí souhlasit s DEVICE_TOKEN na serveru.
#define HOME_CLOUD_ENABLED true
#define HOME_CLOUD_TOKEN ""
#define HOME_CLOUD_URL "https://home-asisstent-v20-production.up.railway.app/api/device/sync"
#define HOME_CLOUD_INTERVAL_MS 2000

// Complete tablet dashboard stored in flash (gzip).
const uint8_t TABLET_HTML_GZIP[] PROGMEM = {
  0x1f,0x8b,0x08,0x00,0x00,0x00,0x00,0x00,0x02,0x0a,0xdd,0x7d,0xdb,0x8e,0x1b,0x57,0xb6,0xd8,0xbb,0xbe,
  0xa2,0xd4,0x9e,0x51,0x91,0x16,0xc9,0x26,0x8b,0xcd,0xbe,0x90,0xcd,0x56,0x24,0x59,0x1e,0xc9,0x63,0x5d,
  0x20,0x69,0xe4,0x44,0x42,0x63,0x50,0x64,0xed,0x6e,0x96,0x58,0xac,0x62,0xea,0xc2,0x16,0xbb,0x9b,0xc0,
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  0xbd,0x85,0xa1,0x79,0x2d,0xd3,0x00,0x00,
};

// ==================== config.h ====================
// Provisional ESP32-WROOM / generic 4 MB esp32dev. Confirm exact board before
// upload.
namespace cfg {
constexpr const char *CloudUrl = HOME_CLOUD_URL;
constexpr uint32_t CloudIntervalMs = HOME_CLOUD_INTERVAL_MS;
static_assert(CloudIntervalMs >= 1000 && CloudIntervalMs <= 10000, "Interval synchronizace musi byt 1 az 10 s");
// Original kitchen hardware: outdoor DHT22 remains on GPIO32.
constexpr int IndoorDht = 27, OutdoorDht = 32, Sda = 21, Scl = 22;
// Relay 1: light below oven. Relay 2: free spare output.
// PowerStatus is unused (TpsStatusInstalled=false).
constexpr int Relay = 26, Relay2 = 33, Button = 23, PowerStatus = 17;
constexpr uint8_t InaAddress = 0x40;
// Original v1.8.10 confirms both relay modules ACTIVE LOW. -1 disables outputs.
constexpr int RelayActiveLevel = 0;
constexpr bool RelayRestoreOnBoot = false;
constexpr uint32_t RelayMinimumSwitchMs = 500;
constexpr bool RelaySafetyConfirmed =
    false; // Required only to enable restoring ON.
constexpr bool ButtonInstalled = false;
constexpr bool TpsStatusInstalled = false;
// Explicit first-install opt-in for Arduino IDE users; NVS marker prevents
// repeat formatting.
constexpr bool InitializeHistoryOnFirstBoot = false;
// LOW also indicates shutdown. Enable only after validating VIN2 + hardware
// priority mode.
constexpr bool TpsLowIsVerifiedBackup = false;
constexpr uint32_t SensorIntervalMs = 5000, StaleMs = 15000;
constexpr uint32_t HistoryIntervalMs = 300000, CheckpointMs = 1800000;
constexpr unsigned HistoryCapacity = 288, EventCapacity = 48;
constexpr float SolarCurrentSign =
    1.0f; // +1 or -1, verify IN+/IN- and production direction.
constexpr bool SolarDirectionConfirmed = false;
constexpr const char *SolarLocation =
    "NEOVĚŘENO: místo INA219 na solární větvi";
constexpr const char *Hostname = "homeassistant-esp32";
constexpr const char *Timezone = "CET-1CEST,M3.5.0,M10.5.0/3";
constexpr const char *Ntp1 =
    "pool.ntp.org"; // May be changed to a local NTP server.
constexpr const char *Ntp2 = "time.cloudflare.com";
constexpr const char *FirmwareVersion = "3.1.1-bmp280-dht22";
constexpr bool uniquePins() {
  const int pins[] = {IndoorDht, OutdoorDht, Sda,    Scl,
                      Relay,     Relay2,     Button, PowerStatus};
  for (unsigned i = 0; i < 8; ++i)
    for (unsigned j = i + 1; j < 8; ++j)
      if (pins[i] == pins[j])
        return false;
  return true;
}
static_assert(!RelayRestoreOnBoot || RelaySafetyConfirmed,
              "Confirm relay safety before restoring a saved ON state");
static_assert(uniquePins(), "GPIO functions must not overlap");
static_assert(SensorIntervalMs >= 2000, "DHT22 interval must be >= 2 seconds");
constexpr bool criticalPin(int pin) {
  return pin == 0 || pin == 2 || pin == 5 || pin == 12 || pin == 15;
}
static_assert(!criticalPin(Relay) && Relay >= 0 && Relay <= 32 &&
                  !criticalPin(Relay2) && Relay2 >= 0 && Relay2 <= 33,
              "Unsafe relay pin");
static_assert(RelayActiveLevel >= -1 && RelayActiveLevel <= 1,
              "Invalid relay polarity");
static_assert(SolarCurrentSign == 1 || SolarCurrentSign == -1,
              "Invalid current sign");
} // namespace cfg

// ==================== src/core/logic.h ====================
namespace logic {
inline float missing() { return std::numeric_limits<float>::quiet_NaN(); }
inline bool climateValid(float t, float h) {
  return std::isfinite(t) && std::isfinite(h) && t >= -40 && t <= 80 &&
         h >= 0 && h <= 100;
}
inline bool solarValid(float bus, float shunt, float current, bool io,
                       bool overflow) {
  return io && !overflow && std::isfinite(bus) && bus >= 0 && bus <= 26 &&
         std::isfinite(shunt) && std::abs(shunt) <= 320 &&
         std::isfinite(current) && std::abs(current) <= 3200;
}
inline float solarPower(float busV, float shuntMv, float currentMa) {
  return (busV + shuntMv / 1000.0f) * currentMa / 1000.0f;
}
enum class Source { Unknown, Mains, Battery };
inline Source source(bool installed, bool high, bool verifiedBackup) {
  return !installed       ? Source::Unknown
         : high           ? Source::Mains
         : verifiedBackup ? Source::Battery
                          : Source::Unknown;
}
inline const char *sourceName(Source s) {
  return s == Source::Mains     ? "MAINS"
         : s == Source::Battery ? "BATTERY"
                                : "UNKNOWN";
}
struct Climate {
  bool pressureSensor = false;
  float pressure = missing();
  float temperature = missing(), humidity = missing(), minimum = missing(),
        maximum = missing(), minHumidity = missing(), maxHumidity = missing();
  bool valid = false;
  uint64_t lastSuccessMs = 0;
  unsigned errors = 0;
  void readPressure(float t, float p, uint64_t now) {
    pressureSensor = true;
    valid = std::isfinite(t) && t >= -40 && t <= 85 &&
            std::isfinite(p) && p >= 300 && p <= 1100;
    humidity = missing();
    if (!valid) { temperature = pressure = missing(); ++errors; return; }
    temperature = t; pressure = p; lastSuccessMs = now;
    if (!std::isfinite(minimum) || t < minimum) minimum = t;
    if (!std::isfinite(maximum) || t > maximum) maximum = t;
  }
  void read(float t, float h, uint64_t now) {
    valid = climateValid(t, h);
    if (!valid) {
      temperature = humidity = missing();
      ++errors;
      return;
    }
    temperature = t;
    humidity = h;
    lastSuccessMs = now;
    if (!std::isfinite(minimum) || t < minimum)
      minimum = t;
    if (!std::isfinite(maximum) || t > maximum)
      maximum = t;
    if (!std::isfinite(minHumidity) || h < minHumidity)
      minHumidity = h;
    if (!std::isfinite(maxHumidity) || h > maxHumidity)
      maxHumidity = h;
  }
};
struct Energy {
  double wh = 0;
  double totalWh = 0;
  int day = 0;
  bool partial = true;
  uint64_t previousMs = 0;
  float previousPower = 0;
  bool previousValid = false;
  void sample(uint64_t now, float watts, bool valid, int localDay,
              bool directionVerified) {
    // Wall-clock jumps/day changes break the integration segment. Never bridge
    // reboots/errors.
    if (day > 0 && localDay > 0 && localDay < day) {
      previousValid = false;
      return;
    }
    if (localDay > 0 && localDay != day) {
      wh = 0;
      day = localDay;
      partial = true;
      previousValid = false;
    }
    if (!localDay || !directionVerified) {
      previousValid = false;
      return;
    }
    if (valid && previousValid && now >= previousMs &&
        now - previousMs <= 15000) {
      double increment = (static_cast<double>(previousPower) + watts) * 0.5 *
                         (now - previousMs) / 3600000.0;
      wh += increment;
      totalWh += increment;
    }
    previousMs = now;
    previousPower = watts;
    previousValid = valid;
  }
};
struct RelayState {
  bool on = false;
  uint32_t version = 0;
  bool apply(bool next, uint32_t expected) {
    if (expected != version)
      return false;
    if (next != on) {
      on = next;
      ++version;
    }
    return true;
  }
};
inline bool canSwitchRelay(uint64_t last, uint64_t now, uint32_t interval) {
  return last == 0 || now - last >= interval;
}
inline bool constantEqual(const char *a, const char *b) {
  unsigned diff = 0;
  unsigned i = 0;
  for (; a[i] && b[i]; ++i)
    diff |= static_cast<unsigned char>(a[i] ^ b[i]);
  return diff == 0 && a[i] == b[i];
}
} // namespace logic

// ==================== model.h ====================
struct Solar {
  float bus = logic::missing(), shunt = logic::missing(),
        currentMa = logic::missing(), power = logic::missing(),
        rawCurrentMa = logic::missing(), minimum = logic::missing(),
        maximum = logic::missing();
  bool valid = false;
  uint64_t lastSuccessMs = 0;
  unsigned errors = 0;
};
struct State {
  logic::Climate indoor, outdoor;
  Solar solar;
  logic::Energy energy;
  logic::RelayState relay, relay2;
  logic::Source power = logic::Source::Unknown;
  uint64_t relayAppliedMs = 0;
  bool ota = false, storageReady = false;
  uint64_t cloudLastSuccessMs = 0;
  int cloudLastStatus = 0;
  char bootId[17] = {};
};
extern State state;
extern SemaphoreHandle_t stateMutex;
inline uint64_t monotonicMs() { return esp_timer_get_time() / 1000; }
inline State snapshot() {
  xSemaphoreTake(stateMutex, portMAX_DELAY);
  State copy = state;
  xSemaphoreGive(stateMutex);
  return copy;
}
String isoTime();
int localDay();
template <typename Target> inline void nullable(Target target, double value) {
  if (std::isfinite(value))
    target.set(value);
  else
    target.set(nullptr);
}
void addEvent(const char *kind, const char *detail);

// ==================== src/core/json.h ====================
namespace logic {
template <typename Target> inline void jsonNumber(Target target, double value) {
  if (std::isfinite(value))
    target.set(value);
  else
    target.set(nullptr);
}
inline void climateJson(JsonObject o, const Climate &c, uint64_t now,
                        uint64_t staleMs) {
  bool valid =
      c.valid && now >= c.lastSuccessMs && now - c.lastSuccessMs <= staleMs;
  o["available"] = valid;
  o["stale"] = !valid;
  if (c.lastSuccessMs)
    o["ageMs"] = now >= c.lastSuccessMs ? now - c.lastSuccessMs : 0;
  else
    o["ageMs"] = nullptr;
  jsonNumber(o["temperatureC"], valid ? c.temperature : missing());
  o["sensorModel"] = c.pressureSensor ? "BMP280" : "DHT22";
  jsonNumber(o["pressureHpa"], valid ? c.pressure : missing());
  jsonNumber(o["humidityPct"], valid ? c.humidity : missing());
  jsonNumber(o["minTemperatureC"], c.minimum);
  jsonNumber(o["maxTemperatureC"], c.maximum);
  jsonNumber(o["minHumidityPct"], c.minHumidity);
  jsonNumber(o["maxHumidityPct"], c.maxHumidity);
  o["errors"] = c.errors;
  o["extremaScope"] = "since_boot";
}
inline bool validCommand(const JsonDocument &input) {
  if (!input.is<JsonObjectConst>() || !input["state"].is<bool>())
    return false;
  for (JsonPairConst field : input.as<JsonObjectConst>())
    if (strcmp(field.key().c_str(), "state") &&
        strcmp(field.key().c_str(), "requestId") &&
        strcmp(field.key().c_str(), "expectedVersion") &&
        strcmp(field.key().c_str(), "bootId"))
      return false;
  if (!input["expectedVersion"].isUnbound() &&
      !input["expectedVersion"].is<uint32_t>())
    return false;
  if (!input["bootId"].isUnbound() && !input["bootId"].is<const char *>())
    return false;
  if (!input["requestId"].isUnbound()) {
    if (!input["requestId"].is<const char *>())
      return false;
    const char *id = input["requestId"];
    if (!strlen(id) || strlen(id) > 40)
      return false;
    for (unsigned i = 0; id[i]; ++i)
      if (!std::isalnum(static_cast<unsigned char>(id[i])) && id[i] != '-' &&
          id[i] != '_')
        return false;
  }
  return true;
}
} // namespace logic

// ==================== modules.h ====================
void storageBegin();
void storageTask(void *);
void sensorsBegin();
void sensorTask(void *);
void relayBegin();
void relayTask(void *);
void relayPost(uint8_t channel = 1);
void forceRelayOffForOta();
void networkBegin();
void networkTick();
void apiBegin();
void apiTick();
void writeState(JsonDocument &doc, const State &s);
void writeClimate(JsonObject object, const logic::Climate &climate,
                  uint64_t now);
void writeSolar(JsonObject object, const State &s, uint64_t now);
void writeRelay(JsonObject object, const State &s, uint8_t channel = 1);
void writePower(JsonObject object, const State &s);
void writeSystem(JsonObject object, const State &s);
void writeHistory(JsonDocument &doc, unsigned limit);
bool apiAuthorize();
void apiError(int status, const char *code, const char *message);
void apiSend(JsonDocument &doc, int status = 200);
extern WebServer server;

void cloudTask(void *);
void firmwareSetup();
void firmwareLoop();

int executeRelay(uint8_t channel, JsonDocument &input, JsonDocument &doc,
                 uint64_t expires);

// ==================== history.cpp ====================
struct Record {
  uint64_t epoch, uptime;
  char boot[17];
  float ti, to, hi, ho, watts, wh;
};
struct Event {
  uint64_t epoch, uptime;
  char boot[17], kind[16], detail[96];
};
struct Archive {
  uint32_t magic = 0x48413232, version = 2, generation = 0, count = 0, head = 0,
           eventCount = 0, eventHead = 0;
  int day = 0;
  double wh = 0;
  double totalWh = 0;
  Record records[cfg::HistoryCapacity]{};
  Event events[cfg::EventCapacity]{};
};
static Archive archive;
static SemaphoreHandle_t historyMutex;
static bool fsReady = false;
static uint32_t crc(const void *data, size_t size) {
  uint32_t value = ~0u;
  auto bytes = static_cast<const uint8_t *>(data);
  for (size_t i = 0; i < size; ++i) {
    value ^= bytes[i];
    for (unsigned b = 0; b < 8; ++b)
      value = (value >> 1) ^ (0xEDB88320u & -(value & 1));
  }
  return ~value;
}
void addEvent(const char *kind, const char *detail) {
  if (!historyMutex)
    return;
  auto s = snapshot();
  Event e{};
  time_t now = time(nullptr);
  e.epoch = now >= 1700000000 ? now : 0;
  e.uptime = monotonicMs() / 1000;
  strlcpy(e.boot, s.bootId, sizeof(e.boot));
  strlcpy(e.kind, kind, sizeof(e.kind));
  strlcpy(e.detail, detail, sizeof(e.detail));
  xSemaphoreTake(historyMutex, portMAX_DELAY);
  archive.events[archive.eventHead++ % cfg::EventCapacity] = e;
  archive.eventHead %= cfg::EventCapacity;
  archive.eventCount =
      std::min<uint32_t>(archive.eventCount + 1, cfg::EventCapacity);
  xSemaphoreGive(historyMutex);
}
void storageBegin() {
  historyMutex = xSemaphoreCreateMutex();
  configASSERT(historyMutex);
  fsReady = LittleFS.begin(false);
  if (cfg::InitializeHistoryOnFirstBoot) {
    Preferences provision;
    if (provision.begin("home-config", false)) {
      if (!provision.getBool("fs-initialized", false)) {
        if (!fsReady && LittleFS.format())
          fsReady = LittleFS.begin(false);
        if (fsReady)
          provision.putBool("fs-initialized", true);
      }
      provision.end();
    }
  }
  state.storageReady = fsReady;
  if (fsReady) {
    auto loaded = static_cast<Archive *>(malloc(sizeof(Archive)));
    if (loaded) {
      for (const char *path : {"/mixed-history0.bin", "/mixed-history1.bin"}) {
        File file = LittleFS.open(path, "r");
        uint32_t sum = 0;
        if (file && file.size() == sizeof(Archive) + sizeof(sum) &&
            file.readBytes(reinterpret_cast<char *>(loaded), sizeof(Archive)) ==
                sizeof(Archive) &&
            file.readBytes(reinterpret_cast<char *>(&sum), sizeof(sum)) ==
                sizeof(sum) &&
            loaded->magic == archive.magic && loaded->version == 2 &&
            loaded->count <= cfg::HistoryCapacity &&
            loaded->head < cfg::HistoryCapacity &&
            loaded->eventCount <= cfg::EventCapacity &&
            loaded->eventHead < cfg::EventCapacity &&
            std::isfinite(loaded->wh) && std::isfinite(loaded->totalWh) &&
            sum == crc(loaded, sizeof(Archive)) &&
            loaded->generation >= archive.generation)
          archive = *loaded;
        file.close();
      }
      free(loaded);
    }
  }
  state.energy.day = archive.day;
  state.energy.wh = archive.wh;
  state.energy.totalWh = archive.totalWh;
  state.energy.partial = true;
  addEvent("restart", "Restart ESP32; denní energie může být neúplná");
}
static void checkpoint(const State &s) {
  if (!fsReady)
    return;
  auto copy = static_cast<Archive *>(malloc(sizeof(Archive)));
  if (!copy) {
    addEvent("storage", "Nedostatek paměti pro checkpoint");
    return;
  }
  xSemaphoreTake(historyMutex, portMAX_DELAY);
  archive.day = s.energy.day;
  archive.wh = s.energy.wh;
  archive.totalWh = s.energy.totalWh;
  ++archive.generation;
  *copy = archive;
  xSemaphoreGive(historyMutex);
  uint32_t sum = crc(copy, sizeof(Archive));
  const char *target = copy->generation % 2 ? "/mixed-history1.bin" : "/mixed-history0.bin";
  File file = LittleFS.open("/history.tmp", "w");
  bool ok =
      file &&
      file.write(reinterpret_cast<uint8_t *>(copy), sizeof(Archive)) ==
          sizeof(Archive) &&
      file.write(reinterpret_cast<uint8_t *>(&sum), sizeof(sum)) == sizeof(sum);
  file.flush();
  file.close();
  free(copy);
  if (ok) {
    LittleFS.remove(target);
    ok = LittleFS.rename("/history.tmp", target);
  }
  if (!ok) {
    xSemaphoreTake(stateMutex, portMAX_DELAY);
    state.storageReady = false;
    xSemaphoreGive(stateMutex);
    addEvent("storage", "Uložení historie selhalo");
  }
}
void storageTask(void *) {
  esp_task_wdt_add(nullptr);
  uint64_t recorded = 0, saved = monotonicMs(), relayChanged = 0;
  bool lastRelay = snapshot().relay.on, persisted = lastRelay;
  bool lastRelay2 = snapshot().relay2.on, persisted2 = lastRelay2;
  uint64_t relay2Changed = 0;
  for (;;) {
    esp_task_wdt_reset();
    uint64_t now = monotonicMs();
    auto s = snapshot();
    if (now - recorded >= cfg::HistoryIntervalMs) {
      recorded = now;
      time_t epoch = time(nullptr);
      Record r{};
      r.epoch = epoch >= 1700000000 ? epoch : 0;
      r.uptime = now / 1000;
      strlcpy(r.boot, s.bootId, sizeof(r.boot));
      r.ti = s.indoor.valid && now - s.indoor.lastSuccessMs <= cfg::StaleMs
                 ? s.indoor.temperature
                 : logic::missing();
      r.to = s.outdoor.valid && now - s.outdoor.lastSuccessMs <= cfg::StaleMs
                 ? s.outdoor.temperature
                 : logic::missing();
      r.hi = s.indoor.valid && now - s.indoor.lastSuccessMs <= cfg::StaleMs
                 ? s.indoor.pressure
                 : logic::missing();
      r.ho = s.outdoor.valid && now - s.outdoor.lastSuccessMs <= cfg::StaleMs
                 ? s.outdoor.humidity
                 : logic::missing();
      r.watts = s.solar.valid && now - s.solar.lastSuccessMs <= cfg::StaleMs
                    ? s.solar.power
                    : logic::missing();
      r.wh = cfg::SolarDirectionConfirmed && s.energy.day == localDay() &&
                     s.energy.day
                 ? s.energy.wh
                 : logic::missing();
      xSemaphoreTake(historyMutex, portMAX_DELAY);
      archive.records[archive.head++ % cfg::HistoryCapacity] = r;
      archive.head %= cfg::HistoryCapacity;
      archive.count =
          std::min<uint32_t>(archive.count + 1, cfg::HistoryCapacity);
      xSemaphoreGive(historyMutex);
    }
    if (s.relay.on != lastRelay) {
      lastRelay = s.relay.on;
      relayChanged = now;
    }
    if (cfg::RelayRestoreOnBoot && lastRelay != persisted &&
        now - relayChanged >= 30000) {
      Preferences prefs;
      if (prefs.begin("home", false)) {
        if (prefs.putBool("relay", lastRelay))
          persisted = lastRelay;
        prefs.end();
      }
    }
    if (s.relay2.on != lastRelay2) {
      lastRelay2 = s.relay2.on;
      relay2Changed = now;
    }
    if (cfg::RelayRestoreOnBoot && lastRelay2 != persisted2 &&
        now - relay2Changed >= 30000) {
      Preferences prefs;
      if (prefs.begin("home", false)) {
        if (prefs.putBool("relay2", lastRelay2))
          persisted2 = lastRelay2;
        prefs.end();
      }
    }
    if (now - saved >= cfg::CheckpointMs) {
      saved = now;
      checkpoint(s);
    }
    vTaskDelay(pdMS_TO_TICKS(1000));
  }
}
void writeHistory(JsonDocument &doc, unsigned limit) {
  doc["capacity"] = cfg::HistoryCapacity;
  doc["intervalSeconds"] = cfg::HistoryIntervalMs / 1000;
  doc["retentionHours"] = 24;
  doc["checkpointSeconds"] = cfg::CheckpointMs / 1000;
  xSemaphoreTake(historyMutex, portMAX_DELAY);
  auto records = doc["records"].to<JsonArray>();
  unsigned count = std::min<uint32_t>(limit, archive.count);
  for (unsigned i = archive.count - count; i < archive.count; ++i) {
    const auto &r =
        archive
            .records[(archive.head + cfg::HistoryCapacity - archive.count + i) %
                     cfg::HistoryCapacity];
    auto o = records.add<JsonObject>();
    if (r.epoch)
      o["epochSeconds"] = r.epoch;
    else
      o["epochSeconds"] = nullptr;
    o["uptimeSeconds"] = r.uptime;
    o["bootId"] = r.boot;
    nullable(o["indoorTemperature"], r.ti);
    nullable(o["outdoorTemperature"], r.to);
    nullable(o["indoorPressure"], r.hi);
    nullable(o["outdoorHumidity"], r.ho);
    nullable(o["solarPower"], r.watts);
    nullable(o["solarEnergy"], r.wh);
  }
  auto events = doc["events"].to<JsonArray>();
  for (unsigned i = 0; i < archive.eventCount; ++i) {
    const auto &e = archive.events[(archive.eventHead + cfg::EventCapacity -
                                    archive.eventCount + i) %
                                   cfg::EventCapacity];
    auto o = events.add<JsonObject>();
    if (e.epoch)
      o["epochSeconds"] = e.epoch;
    else
      o["epochSeconds"] = nullptr;
    o["uptimeSeconds"] = e.uptime;
    o["bootId"] = e.boot;
    o["kind"] = e.kind;
    o["detail"] = e.detail;
  }
  xSemaphoreGive(historyMutex);
}

// ==================== sensors.cpp ====================
static Adafruit_BMP280 indoor(&Wire);
static DHT outdoor(cfg::OutdoorDht, DHT22);
static bool indoorReady = false;
static bool beginBmp(Adafruit_BMP280 &bmp) {
  if (!bmp.begin(0x76) && !bmp.begin(0x77)) return false;
  bmp.setSampling(Adafruit_BMP280::MODE_NORMAL, Adafruit_BMP280::SAMPLING_X2,
                  Adafruit_BMP280::SAMPLING_X16, Adafruit_BMP280::FILTER_X16,
                  Adafruit_BMP280::STANDBY_MS_500);
  return true;
}
static Adafruit_INA219 ina(cfg::InaAddress);
void sensorsBegin() {
  outdoor.begin();
  Wire.begin(cfg::Sda, cfg::Scl, 100000);
  Wire.setTimeOut(50);
}
// Check the raw bus overflow bit in addition to every library transaction
// result.
static bool busRegister(uint16_t &raw) {
  Wire.beginTransmission(cfg::InaAddress);
  Wire.write(0x02);
  if (Wire.endTransmission(false) != 0)
    return false;
  if (Wire.requestFrom(cfg::InaAddress, static_cast<uint8_t>(2)) != 2)
    return false;
  raw = (Wire.read() << 8) | Wire.read();
  return true;
}
void sensorTask(void *) {
  esp_task_wdt_add(nullptr);
  sensorsBegin();
  bool initialized = false;
  TickType_t wake = xTaskGetTickCount();
  for (;;) {
    esp_task_wdt_reset();
    auto old = snapshot();
    auto in = old.indoor, out = old.outdoor;
    auto sol = old.solar;
    auto energy = old.energy;
    uint64_t now = monotonicMs();
    if (!indoorReady) indoorReady = beginBmp(indoor);
    in.readPressure(indoorReady ? indoor.readTemperature() : logic::missing(),
                    indoorReady ? indoor.readPressure()/100.0f : logic::missing(), now);
    out.read(outdoor.readTemperature(), outdoor.readHumidity(), now);
    indoorReady = in.valid;
    if (!initialized) {
      initialized = ina.begin(&Wire);
      if (initialized)
        ina.setCalibration_32V_2A();
    }
    uint16_t raw = 0;
    bool io = initialized && busRegister(raw);
    float v = io ? ina.getBusVoltage_V() : logic::missing();
    io = io && ina.success();
    float shunt = io ? ina.getShuntVoltage_mV() : logic::missing();
    io = io && ina.success();
    float rawCurrent = io ? ina.getCurrent_mA() : logic::missing();
    float current = rawCurrent * cfg::SolarCurrentSign;
    io = io && ina.success();
    uint16_t after = 0;
    io = io && busRegister(after);
    sol.valid =
        logic::solarValid(v, shunt, current, io, (raw & 1) || (after & 1));
    if (sol.valid) {
      sol.bus = v;
      sol.shunt = shunt;
      sol.currentMa = current;
      sol.rawCurrentMa = rawCurrent;
      sol.power = logic::solarPower(v, shunt, current);
      if (!std::isfinite(sol.minimum) || sol.power < sol.minimum)
        sol.minimum = sol.power;
      if (!std::isfinite(sol.maximum) || sol.power > sol.maximum)
        sol.maximum = sol.power;
      sol.lastSuccessMs = now;
    } else {
      sol.bus = sol.shunt = sol.rawCurrentMa = sol.currentMa = sol.power =
          logic::missing();
      ++sol.errors;
      initialized = false;
    }
    energy.sample(now, sol.power, sol.valid, localDay(),
                  cfg::SolarDirectionConfirmed);
    xSemaphoreTake(stateMutex, portMAX_DELAY);
    state.indoor = in;
    state.outdoor = out;
    state.solar = sol;
    state.energy = energy;
    xSemaphoreGive(stateMutex);
    if (in.valid != old.indoor.valid)
      addEvent("sensor",
               in.valid ? "Vnitřní BMP280 obnoven" : "Vnitřní BMP280 nedostupný");
    if (out.valid != old.outdoor.valid)
      addEvent("sensor", out.valid ? "Venkovní DHT22 obnoven"
                                   : "Venkovní DHT22 nedostupný");
    if (sol.valid != old.solar.valid)
      addEvent("sensor", sol.valid ? "INA219 obnoven" : "INA219 nedostupný");
    // Initial failed samples also need an event (initial state is already
    // invalid).
    if (in.errors == 1 && !in.valid)
      addEvent("sensor", "První čtení vnitřního BMP280 selhalo");
    if (out.errors == 1 && !out.valid)
      addEvent("sensor", "První čtení venkovního DHT22 selhalo");
    if (sol.errors == 1 && !sol.valid)
      addEvent("sensor", "První čtení INA219 selhalo");
    vTaskDelayUntil(&wake, pdMS_TO_TICKS(cfg::SensorIntervalMs));
  }
}

// ==================== relay.cpp ====================
struct Command {
  uint8_t channel;
  bool on;
  uint32_t expected;
  char id[41];
  uint64_t expires = 0;
};
struct Result {
  uint8_t channel = 1;
  char id[41] = {};
  bool on = false;
  int status = 0;
  uint32_t version = 0;
};
static QueueHandle_t commands;
static SemaphoreHandle_t relayCommandMutex;
static Result results[8];
static unsigned resultHead = 0;
static uint64_t switchedAt[2] = {};
static bool enabled() {
  return cfg::RelayActiveLevel == 0 || cfg::RelayActiveLevel == 1;
}
void relayBegin() {
  relayCommandMutex=xSemaphoreCreateMutex();
  configASSERT(relayCommandMutex);
  commands = xQueueCreate(2, sizeof(Command));
  configASSERT(commands);
  for (int pin : {cfg::Relay, cfg::Relay2}) {
    if (enabled()) {
      digitalWrite(pin, !cfg::RelayActiveLevel);
      pinMode(pin, OUTPUT);
      digitalWrite(pin, !cfg::RelayActiveLevel);
    } else
      pinMode(pin, INPUT);
  } // External verified inactive bias is required
    // before connecting relay.
  if (cfg::ButtonInstalled)
    pinMode(cfg::Button, INPUT_PULLUP);
  if (cfg::TpsStatusInstalled)
    pinMode(cfg::PowerStatus, INPUT); // External 3.3 V pull-up required.
  if (enabled() && cfg::RelayRestoreOnBoot) {
    Preferences prefs;
    if (prefs.begin("home", true)) {
      state.relay.on = prefs.getBool("relay", false);
      state.relay2.on = prefs.getBool("relay2", false);
      prefs.end();
    }
    digitalWrite(cfg::Relay, state.relay.on ? cfg::RelayActiveLevel
                                            : !cfg::RelayActiveLevel);
    digitalWrite(cfg::Relay2, state.relay2.on ? cfg::RelayActiveLevel
                                              : !cfg::RelayActiveLevel);
  }
}
static int apply(uint8_t channel, bool on, uint32_t expected) {
  xSemaphoreTake(stateMutex, portMAX_DELAY);
  auto &relay = channel == 1 ? state.relay : state.relay2;
  int status = !enabled() || state.ota     ? 503
               : relay.version != expected ? 409
               : relay.on != on && !logic::canSwitchRelay(
                                       switchedAt[channel - 1], monotonicMs(),
                                       cfg::RelayMinimumSwitchMs)
                   ? 429
                   : 200;
  if (status == 200) {
    if (relay.on != on)
      switchedAt[channel - 1] = monotonicMs();
    digitalWrite(channel == 1 ? cfg::Relay : cfg::Relay2,
                 on ? cfg::RelayActiveLevel : !cfg::RelayActiveLevel);
    relay.apply(on, expected);
    state.relayAppliedMs = monotonicMs();
  }
  xSemaphoreGive(stateMutex);
  return status;
}
void forceRelayOffForOta() {
  xSemaphoreTake(stateMutex, portMAX_DELAY);
  state.ota = true;
  if (enabled()) {
    digitalWrite(cfg::Relay, !cfg::RelayActiveLevel);
    digitalWrite(cfg::Relay2, !cfg::RelayActiveLevel);
    state.relay.apply(false, state.relay.version);
    state.relay2.apply(false, state.relay2.version);
    state.relayAppliedMs = monotonicMs();
  }
  xSemaphoreGive(stateMutex);
}
void relayTask(void *) {
  esp_task_wdt_add(nullptr);
  bool raw = true, stable = true;
  uint64_t changed = 0;
  for (;;) {
    esp_task_wdt_reset();
    Command command;
    if (xQueueReceive(commands, &command, 0) == pdTRUE) {
      int status = command.expires && monotonicMs() >= command.expires
                       ? 408
                       : apply(command.channel, command.on, command.expected);
      auto s = snapshot();
      xSemaphoreTake(stateMutex, portMAX_DELAY);
      auto &result = results[resultHead++ % 8];
      strlcpy(result.id, command.id, sizeof(result.id));
      result.channel = command.channel;
      result.on = command.on;
      result.status = status;
      result.version =
          command.channel == 1 ? s.relay.version : s.relay2.version;
      xSemaphoreGive(stateMutex);
      if (status == 200) {
        char detail[64];
        snprintf(detail, sizeof(detail), "Relé %u: GPIO %s", command.channel,
                 command.on ? "zapnout" : "vypnout");
        addEvent("relay", detail);
      }
    }
    if (cfg::ButtonInstalled) {
      bool next = digitalRead(cfg::Button);
      if (next != raw) {
        raw = next;
        changed = monotonicMs();
      }
      if (raw != stable && monotonicMs() - changed >= 50) {
        stable = raw;
        if (!stable) {
          auto s = snapshot();
          if (apply(1, !s.relay.on, s.relay.version) == 200)
            addEvent("relay", "Místní tlačítko: změna GPIO");
        }
      }
    }
    auto old = snapshot();
    auto source =
        logic::source(cfg::TpsStatusInstalled,
                      cfg::TpsStatusInstalled && digitalRead(cfg::PowerStatus),
                      cfg::TpsLowIsVerifiedBackup);
    // Debounce status separately from the physical switch.
    static auto candidate = logic::Source::Unknown;
    static uint64_t since = 0;
    if (source != candidate) {
      candidate = source;
      since = monotonicMs();
    }
    if (source != old.power && monotonicMs() - since >= 250) {
      xSemaphoreTake(stateMutex, portMAX_DELAY);
      state.power = source;
      xSemaphoreGive(stateMutex);
      addEvent("power", logic::sourceName(source));
    }
    vTaskDelay(pdMS_TO_TICKS(10));
  }
}
int executeRelay(uint8_t channel, JsonDocument &input, JsonDocument &doc,
                 uint64_t expires) {
  auto reject = [&](int status, const char *code, const char *message) {
    doc["apiVersion"] = 1;
    doc["error"]["code"] = code;
    doc["error"]["message"] = message;
    return status;
  };
  if ((channel != 1 && channel != 2) || !logic::validCommand(input))
    return reject(400, "invalid_body", "Neplatný příkaz relé.");
  for (JsonPair field : input.as<JsonObject>())
    if (strcmp(field.key().c_str(), "state") &&
        strcmp(field.key().c_str(), "expectedVersion") &&
        strcmp(field.key().c_str(), "requestId") &&
        strcmp(field.key().c_str(), "bootId")) {
      return reject(400, "unknown_field", "Neznámé pole příkazu.");
    }
  if (xSemaphoreTake(relayCommandMutex, pdMS_TO_TICKS(800)) != pdTRUE)
    return reject(429, "busy", "Relé zpracovává jiný příkaz.");
  struct CommandGuard { ~CommandGuard() { xSemaphoreGive(relayCommandMutex); } } guard;
  auto s = snapshot();
  if (input["bootId"].is<const char *>() &&
      String(input["bootId"].as<const char *>()) != s.bootId) {
    return reject(409, "restarted",
                  "ESP32 se restartovalo. Načtěte nový stav.");
  }
  if (!input["bootId"].isNull() && !input["bootId"].is<const char *>()) {
    return reject(400, "boot_id", "Neplatné bootId.");
  }
  if (!input["expectedVersion"].isNull() &&
      !input["expectedVersion"].is<uint32_t>()) {
    return reject(400, "version", "Neplatná verze relé.");
  }
  String id = input["requestId"].is<const char *>()
                  ? input["requestId"].as<const char *>()
                  : String(s.bootId) + "-" +
                        String(static_cast<unsigned long>(esp_random()));
  if (!input["requestId"].isNull() && !input["requestId"].is<const char *>()) {
    return reject(400, "request_id", "Neplatné requestId.");
  }
  if (!id.length() || id.length() > 40) {
    return reject(400, "request_id", "requestId musí mít 1–40 znaků.");
  }
  for (unsigned i = 0; i < id.length(); ++i)
    if (!isalnum(id[i]) && id[i] != '-' && id[i] != '_') {
      return reject(400, "request_id", "Neplatné znaky requestId.");
    }
  bool on = input["state"].as<bool>();
  Result found;
  xSemaphoreTake(stateMutex, portMAX_DELAY);
  for (const auto &result : results)
    if (id == result.id)
      found = result;
  xSemaphoreGive(stateMutex);
  if (found.status) {
    if (found.on != on || found.channel != channel) {
      return reject(409, "duplicate_conflict",
                    "requestId již patří jinému příkazu.");
    }
    if (found.status != 200) {
      return reject(found.status, "command_rejected", "Příkaz nebyl přijat.");
    }
  } else {
    Command cmd{channel,
                on,
                input["expectedVersion"].isNull()
                    ? (channel == 1 ? s.relay.version : s.relay2.version)
                    : input["expectedVersion"].as<uint32_t>(),
                {}};
    cmd.expires = expires;
    strlcpy(cmd.id, id.c_str(), sizeof(cmd.id));
    if (xQueueSend(commands, &cmd, 0) != pdTRUE) {
      return reject(429, "busy", "Relé zpracovává jiný příkaz.");
    }
    uint64_t started = monotonicMs();
    while (monotonicMs() - started < 750 && !found.status) {
      xSemaphoreTake(stateMutex, portMAX_DELAY);
      for (const auto &r : results)
        if (id == r.id)
          found = r;
      xSemaphoreGive(stateMutex);
      delay(5);
    }
    if (found.status != 200) {
      return reject(
          found.status ? found.status : 504,
          found.status == 409 ? "conflict" : "command_failed",
          found.status == 409
              ? "Stav změnil jiný klient. Načtěte jej znovu."
              : "GPIO příkaz nebyl potvrzen. Ověřte konfiguraci relé a "
                "nový stav.");
    }
  }
  doc["apiVersion"] = 1;
  doc["requestId"] = id;
  doc["applied"] = true;
  doc["appliedVersion"] = found.version;
  doc["requestedState"] = on;
  doc["bootId"] = s.bootId;
  auto current = snapshot();
  auto &confirmed = channel == 1 ? current.relay : current.relay2;
  confirmed.on = found.on;
  confirmed.version = found.version;
  doc["channel"] = channel;
  writeRelay(doc["relays"][String(channel)].to<JsonObject>(), current, channel);
  if (channel == 1)
    writeRelay(doc["lighting"]["kitchenLed"].to<JsonObject>(), current);
  return 200;
}

void relayPost(uint8_t channel) {
  if (!apiAuthorize())
    return;
  if (server.header("Content-Type").indexOf("application/json") != 0) {
    apiError(415, "content_type", "Použijte application/json.");
    return;
  }
  if (server.arg("plain").length() > 512) {
    apiError(413, "body_size", "Příkaz je příliš velký.");
    return;
  }
  JsonDocument input;
  if (deserializeJson(input, server.arg("plain")) ||
      !logic::validCommand(input)) {
    apiError(400, "invalid_body",
             "Neplatný příkaz; state musí být boolean a ostatní pole musí "
             "odpovídat API v1.");
    return;
  }
  JsonDocument doc;
  int status = executeRelay(channel, input, doc, 0);
  apiSend(doc, status);
}

// ==================== network.cpp ====================
static bool connected = false, otaStarted = false;
static uint64_t retryAt = 0;
static unsigned backoff = 2000;
static_assert(
    !(HOME_OTA_ENABLED && cfg::RelayRestoreOnBoot),
    "OTA requires RelayRestoreOnBoot=false to guarantee OFF after update");
void networkBegin() {
  retryAt = monotonicMs() + 10000;
  WiFi.persistent(false);
  WiFi.mode(WIFI_STA);
  WiFi.setHostname(cfg::Hostname);
  WiFi.setAutoReconnect(false);
  if (strlen(HOME_WIFI_SSID))
    WiFi.begin(HOME_WIFI_SSID, HOME_WIFI_PASSWORD);
  configTzTime(cfg::Timezone, cfg::Ntp1, cfg::Ntp2);
}
void networkTick() {
  bool up = WiFi.status() == WL_CONNECTED;
  if (up && !connected) {
    connected = true;
    backoff = 2000;
    MDNS.end();
    if (MDNS.begin(cfg::Hostname))
      MDNS.addService("http", "tcp", 80);
    addEvent("wifi", "Wi-Fi připojeno");
    Serial.print("LAN IP: ");
    Serial.println(WiFi.localIP());
    if (HOME_OTA_ENABLED && strlen(HOME_OTA_PASSWORD) >= 16) {
      ArduinoOTA.setHostname(cfg::Hostname);
      ArduinoOTA.setPassword(HOME_OTA_PASSWORD);
      ArduinoOTA.onProgress(
          [](unsigned int, unsigned int) { esp_task_wdt_reset(); });
      ArduinoOTA.onStart([]() { forceRelayOffForOta(); });
      ArduinoOTA.onError([](ota_error_t) {
        addEvent("ota", "Aktualizace selhala; relé zůstává vypnuté");
      });
      ArduinoOTA.begin();
      otaStarted = true;
    }
  }
  if (!up && connected) {
    connected = false;
    MDNS.end();
    addEvent("wifi", "Wi-Fi odpojeno");
  }
  if (!up && strlen(HOME_WIFI_SSID) && monotonicMs() >= retryAt) {
    WiFi.disconnect(false, false);
    WiFi.begin(HOME_WIFI_SSID, HOME_WIFI_PASSWORD);
    retryAt = monotonicMs() + backoff;
    backoff = std::min(backoff * 2, 60000u);
  }
  if (up && otaStarted)
    ArduinoOTA.handle();
}

// ==================== direct-web.cpp ====================
// Local dashboard without a login password.
static bool sameDeviceOrigin() {
  String origin = server.header("Origin");
  return origin.length() && origin == String("http://") + server.hostHeader();
}

void directWebBegin() {
  server.on("/", HTTP_GET, []() {
    server.sendHeader("Content-Encoding", "gzip");
    server.sendHeader("Cache-Control", "no-store");
    server.sendHeader("X-Content-Type-Options", "nosniff");
    server.send_P(200, "text/html; charset=utf-8",
                  reinterpret_cast<const char *>(TABLET_HTML_GZIP),
                  sizeof(TABLET_HTML_GZIP));
  });
  server.on("/favicon.ico", HTTP_GET, []() { server.send(204); });
}

// ==================== api.cpp ====================
WebServer server(80);
static const char *headers[] = {"Authorization", "Origin", "Content-Type", "Cookie"};
static void responseHeaders() {
  server.sendHeader("Cache-Control", "no-store");
  server.sendHeader("X-Content-Type-Options", "nosniff");
  if (strlen(HOME_ALLOWED_ORIGIN) &&
      server.header("Origin") == HOME_ALLOWED_ORIGIN) {
    server.sendHeader("Access-Control-Allow-Origin", HOME_ALLOWED_ORIGIN);
    server.sendHeader("Vary", "Origin");
  }
}
void apiSend(JsonDocument &doc, int status) {
  responseHeaders();
  if (doc.overflowed()) {
    server.send(503, "application/json",
                "{\"error\":{\"message\":\"Nedostatek paměti API.\"}}");
    return;
  }
  // Avoid a second full history-sized allocation; batch TCP writes.
  class BufferedClient : public Print {
    WiFiClient client;
    uint8_t buffer[512];
    size_t used = 0;

  public:
    explicit BufferedClient(WiFiClient c) : client(c) {}
    void flush() {
      if (used) {
        client.write(buffer, used);
        used = 0;
      }
    }
    size_t write(uint8_t c) override {
      buffer[used++] = c;
      if (used == sizeof(buffer))
        flush();
      return 1;
    }
  } output(server.client());
  server.setContentLength(measureJson(doc));
  server.send(status, "application/json; charset=utf-8", "");
  serializeJson(doc, output);
  output.flush();
}
void apiError(int status, const char *code, const char *message) {
  JsonDocument doc;
  doc["apiVersion"] = 1;
  doc["error"]["code"] = code;
  doc["error"]["message"] = message;
  apiSend(doc, status);
}
bool apiAuthorize() {
  String origin = server.header("Origin");
  if (origin.length() && !sameDeviceOrigin() &&
      (!strlen(HOME_ALLOWED_ORIGIN) || origin != HOME_ALLOWED_ORIGIN)) {
    apiError(403, "origin", "Tento původ není povolen.");
    return false;
  }
  return true;
}
static void stamp(JsonObject object, uint64_t ms, uint64_t now, bool valid) {
  object["available"] = valid && now >= ms && now - ms <= cfg::StaleMs;
  object["stale"] = !valid || now < ms || now - ms > cfg::StaleMs;
  if (ms)
    object["ageMs"] = now >= ms ? now - ms : 0;
  else
    object["ageMs"] = nullptr;
}
void writeClimate(JsonObject o, const logic::Climate &c, uint64_t now) {
  logic::climateJson(o, c, now, cfg::StaleMs);
  if (c.lastSuccessMs && isoTime().length()) {
    time_t epoch =
        time(nullptr) - static_cast<time_t>((now - c.lastSuccessMs) / 1000);
    struct tm t;
    gmtime_r(&epoch, &t);
    char text[25];
    strftime(text, sizeof(text), "%Y-%m-%dT%H:%M:%SZ", &t);
    o["readingTimestamp"] = text;
  } else
    o["readingTimestamp"] = nullptr;
}
void writeSolar(JsonObject o, const State &s, uint64_t now) {
  stamp(o, s.solar.lastSuccessMs, now, s.solar.valid);
  bool valid = o["available"].as<bool>();
  nullable(o["voltageV"], valid ? s.solar.bus : logic::missing());
  nullable(o["shuntVoltageMv"], valid ? s.solar.shunt : logic::missing());
  nullable(o["currentMa"], valid ? s.solar.currentMa : logic::missing());
  nullable(o["rawCurrentMa"], valid ? s.solar.rawCurrentMa : logic::missing());
  nullable(o["minPowerW"], s.solar.minimum);
  nullable(o["maxPowerW"], s.solar.maximum);
  o["extremaScope"] = "since_boot";
  nullable(o["energyTotalWh"],
           cfg::SolarDirectionConfirmed ? s.energy.totalWh : logic::missing());
  o["totalScope"] = "monitored_signed_energy_since_installation";
  nullable(o["currentA"],
           valid ? s.solar.currentMa / 1000.0f : logic::missing());
  nullable(o["powerW"], valid ? s.solar.power : logic::missing());
  nullable(o["energyTodayWh"], cfg::SolarDirectionConfirmed && s.energy.day &&
                                       s.energy.day == localDay()
                                   ? s.energy.wh
                                   : logic::missing());
  o["energyPartial"] = s.energy.partial;
  if (s.energy.day)
    o["energyDay"] = String(s.energy.day);
  else
    o["energyDay"] = nullptr;
  o["directionConfirmed"] = cfg::SolarDirectionConfirmed;
  o["measurementLocation"] = cfg::SolarLocation;
  o["errors"] = s.solar.errors;
}
void writeRelay(JsonObject o, const State &s, uint8_t channel) {
  const auto &relay = channel == 1 ? s.relay : s.relay2;
  o["commandedOn"] = relay.on;
  o["version"] = relay.version;
  o["controlAvailable"] = (cfg::RelayActiveLevel >= 0) && !s.ota;
  o["feedbackAvailable"] = false;
  o["physicalOn"] = nullptr;
  o["acknowledgement"] = "gpio_command_only";
  o["appliedUptimeMs"] = s.relayAppliedMs;
}
void writePower(JsonObject o, const State &s) {
  o["activeSource"] = logic::sourceName(s.power);
  o["statusInstalled"] = cfg::TpsStatusInstalled;
  o["backupVerified"] = cfg::TpsLowIsVerifiedBackup;
  o["statusLowAmbiguous"] =
      cfg::TpsStatusInstalled && s.power != logic::Source::Mains;
  o["batteryVoltageV"] = nullptr;
  o["batterySocPct"] = nullptr;
  o["batteryCurrentA"] = nullptr;
  o["batteryChargeStatus"] = nullptr;
  o["switching"] = "hardware_controlled";
  o["tabletPower"] = "independent_mains";
}
void writeSystem(JsonObject o, const State &s) {
  o["firmwareVersion"] = cfg::FirmwareVersion;
  o["buildTimestamp"] = __DATE__ " " __TIME__;
  o["freeHeapBytes"] = ESP.getFreeHeap();
  o["uptimeSeconds"] = monotonicMs() / 1000;
  o["wifiConnected"] = WiFi.status() == WL_CONNECTED;
  if (WiFi.status() == WL_CONNECTED) {
    o["wifiRssiDbm"] = WiFi.RSSI();
    o["ip"] = WiFi.localIP().toString();
  } else {
    o["wifiRssiDbm"] = nullptr;
    o["ip"] = nullptr;
  }
  o["rebootReason"] = static_cast<int>(esp_reset_reason());
  o["timeSynchronized"] = isoTime().length() > 0;
  o["storageReady"] = s.storageReady;
  o["otaEnabled"] = HOME_OTA_ENABLED && strlen(HOME_OTA_PASSWORD) >= 16;
  o["otaInProgress"] = s.ota;
  o["hostname"] = cfg::Hostname;
  o["cloudEnabled"] = HOME_CLOUD_ENABLED && strlen(HOME_CLOUD_TOKEN) >= 32;
  o["cloudConnected"] = s.cloudLastSuccessMs && monotonicMs()-s.cloudLastSuccessMs < 15000;
  o["cloudLastStatus"] = s.cloudLastStatus;
  if (s.cloudLastSuccessMs) o["cloudLastSyncAgeMs"] = monotonicMs()-s.cloudLastSuccessMs;
  else o["cloudLastSyncAgeMs"] = nullptr;
}
void writeState(JsonDocument &doc, const State &s) {
  doc["apiVersion"] = 1;
  doc["deviceId"] = cfg::Hostname;
  doc["bootId"] = s.bootId;
  auto timestamp = isoTime();
  if (timestamp.length())
    doc["timestamp"] = timestamp;
  else
    doc["timestamp"] = nullptr;
  doc["uptimeSeconds"] = monotonicMs() / 1000;
  writeClimate(doc["climate"]["indoor"].to<JsonObject>(), s.indoor,
               monotonicMs());
  writeClimate(doc["climate"]["outdoor"].to<JsonObject>(), s.outdoor,
               monotonicMs());
  writeSolar(doc["solar"].to<JsonObject>(), s, monotonicMs());
  writeRelay(doc["lighting"]["kitchenLed"].to<JsonObject>(), s);
  writeRelay(doc["relays"]["1"].to<JsonObject>(), s, 1);
  writeRelay(doc["relays"]["2"].to<JsonObject>(), s, 2);
  writePower(doc["power"].to<JsonObject>(), s);
  writeSystem(doc["system"].to<JsonObject>(), s);
}
void apiBegin() {
  server.collectHeaders(headers, 4);
  directWebBegin();
  for (const char *path :
       {"/api/state", "/api/climate", "/api/solar", "/api/relay", "/api/power",
        "/api/system", "/api/health", "/api/version", "/api/history",
        "/api/relays", "/api/relays/1", "/api/relays/2"}) {
    server.on(path, HTTP_OPTIONS, []() {
      if (!strlen(HOME_ALLOWED_ORIGIN) ||
          server.header("Origin") != HOME_ALLOWED_ORIGIN) {
        apiError(403, "origin", "Původ není povolen.");
        return;
      }
      responseHeaders();
      server.sendHeader("Access-Control-Allow-Methods", "GET, POST, OPTIONS");
      server.sendHeader("Access-Control-Allow-Headers",
                        "Authorization, Content-Type");
      server.send(204);
    });
    String route(path);
    if (route == "/api/relays/1" || route == "/api/relays/2")
      continue;
    server.on(path, HTTP_GET, [route]() {
      if (!apiAuthorize())
        return;
      JsonDocument doc;
      auto s = snapshot();
      writeState(doc, s);
      if (route == "/api/history") {
        doc.clear();
        doc["apiVersion"] = 1;
        unsigned limit = cfg::HistoryCapacity;
        if (server.hasArg("limit")) {
          String v = server.arg("limit");
          for (unsigned i = 0; i < v.length(); ++i)
            if (!isdigit(v[i])) {
              apiError(400, "limit", "Neplatný limit historie.");
              return;
            }
          limit = v.toInt();
          if (limit < 1 || limit > cfg::HistoryCapacity) {
            apiError(400, "limit", "Limit historie je 1–288.");
            return;
          }
        }
        writeHistory(doc, limit);
      } else if (route == "/api/health") {
        doc.clear();
        doc["apiVersion"] = 1;
        doc["status"] = "ok";
        doc["uptimeSeconds"] = monotonicMs() / 1000;
        doc["sensorDegraded"] =
            !s.indoor.valid || !s.outdoor.valid || !s.solar.valid ||
            monotonicMs() - s.indoor.lastSuccessMs > cfg::StaleMs ||
            monotonicMs() - s.outdoor.lastSuccessMs > cfg::StaleMs ||
            monotonicMs() - s.solar.lastSuccessMs > cfg::StaleMs;
        doc["storageReady"] = s.storageReady;
      } else if (route == "/api/version") {
        doc.clear();
        doc["apiVersion"] = 1;
        doc["firmwareVersion"] = cfg::FirmwareVersion;
        doc["buildTimestamp"] = __DATE__ " " __TIME__;
      }
      // Other GETs share the same versioned envelope, with only their requested
      // section.
      else if (route != "/api/state") {
        const char *section = route == "/api/climate"  ? "climate"
                              : route == "/api/solar"  ? "solar"
                              : route == "/api/relay"  ? "lighting"
                              : route == "/api/relays" ? "relays"
                              : route == "/api/power"  ? "power"
                                                       : "system";
        for (const char *name :
             {"climate", "solar", "lighting", "relays", "power", "system"})
          if (strcmp(name, section))
            doc.remove(name);
      }
      apiSend(doc);
    });
  }
  server.on("/api/relay", HTTP_POST, []() { relayPost(1); });
  server.on("/api/relays/1", HTTP_POST, []() { relayPost(1); });
  server.on("/api/relays/2", HTTP_POST, []() { relayPost(2); });
  server.onNotFound(
      []() { apiError(404, "not_found", "Endpoint neexistuje."); });
  server.begin();
}
void apiTick() { server.handleClient(); }


// Official ISRG Root X1/X2 trust anchors, letsencrypt.org/certificates.
static const char CloudRootCa[] = R"PEM(-----BEGIN CERTIFICATE-----
MIIFazCCA1OgAwIBAgIRAIIQz7DSQONZRGPgu2OCiwAwDQYJKoZIhvcNAQELBQAw
TzELMAkGA1UEBhMCVVMxKTAnBgNVBAoTIEludGVybmV0IFNlY3VyaXR5IFJlc2Vh
cmNoIEdyb3VwMRUwEwYDVQQDEwxJU1JHIFJvb3QgWDEwHhcNMTUwNjA0MTEwNDM4
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emyPxgcYxn/eR44/KJ4EBs+lVDR3veyJm+kXQ99b21/+jh5Xos1AnX5iItreGCc=
-----END CERTIFICATE-----
-----BEGIN CERTIFICATE-----
MIICGzCCAaGgAwIBAgIQQdKd0XLq7qeAwSxs6S+HUjAKBggqhkjOPQQDAzBPMQsw
CQYDVQQGEwJVUzEpMCcGA1UEChMgSW50ZXJuZXQgU2VjdXJpdHkgUmVzZWFyY2gg
R3JvdXAxFTATBgNVBAMTDElTUkcgUm9vdCBYMjAeFw0yMDA5MDQwMDAwMDBaFw00
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tL4ndQavEi51mI38AjEAi/V3bNTIZargCyzuFJ0nN6T5U6VR5CmD1/iQMVtCnwr1
/q4AaOeMSQ+2b1tbFfLn
-----END CERTIFICATE-----
)PEM";


class CloudResponse : public Stream {
public:
  String text;
  using Print::write;
  size_t write(uint8_t byte) override {
    if (text.length() >= 4096)
      return 0;
    text += static_cast<char>(byte);
    return 1;
  }
  int available() override { return 0; }
  int read() override { return -1; }
  int peek() override { return -1; }
  void flush() override {}
};

// All TLS work runs separately from sensors, GPIO and the local HTTP server.
void cloudTask(void *) {
  uint32_t sequence = 0, retryMs = 2000;
  JsonDocument ack;
  uint64_t next = 0;
  for (;;) {
    vTaskDelay(pdMS_TO_TICKS(100));
    if (!HOME_CLOUD_ENABLED || strlen(HOME_CLOUD_TOKEN) < 32 || !String(cfg::CloudUrl).startsWith("https://") ||
        WiFi.status() != WL_CONNECTED || time(nullptr) < 1700000000 ||
        snapshot().ota || monotonicMs() < next)
      continue;
    JsonDocument payload, stateDoc;
    writeState(stateDoc, snapshot());
    payload["protocolVersion"] = 1;
    payload["sequence"] = ++sequence;
    payload["state"].set(stateDoc.as<JsonVariant>());
    if (!ack.isNull())
      payload["ack"].set(ack.as<JsonVariant>());
    String body;
    serializeJson(payload, body);
    WiFiClientSecure client;
    client.setCACert(CloudRootCa);
    client.setHandshakeTimeout(5);
    client.setTimeout(3000);
    HTTPClient http;
    http.setConnectTimeout(3000);
    http.setTimeout(3000);
    http.setReuse(false);
    http.setFollowRedirects(HTTPC_DISABLE_FOLLOW_REDIRECTS);
    uint64_t started = monotonicMs();
    int status = -1;
    JsonDocument response;
    if (http.begin(client, cfg::CloudUrl)) {
      http.addHeader("Content-Type", "application/json");
      http.addHeader("Authorization", String("Bearer ") + HOME_CLOUD_TOKEN);
      status = http.POST(body);
      // Bound the response before parsing; the cloud never sends bulk history.
      if (status == 200) {
        CloudResponse incoming;
        if (http.getSize() > 4096 || http.writeToStream(&incoming) < 0 ||
            deserializeJson(response, incoming.text) ||
            response["protocolVersion"].as<int>() != 1)
          status = -2;
      }
      http.end();
    }
    client.stop();
    xSemaphoreTake(stateMutex, portMAX_DELAY);
    state.cloudLastStatus = status;
    if (status == 200) state.cloudLastSuccessMs = monotonicMs();
    xSemaphoreGive(stateMutex);
    if (status != 200) {
      Serial.printf("Cloud: spojeni selhalo (%d), opakovani za %lu ms\n",
                    status, static_cast<unsigned long>(retryMs));
      next = monotonicMs() + retryMs;
      retryMs = min(retryMs * 2, uint32_t(60000));
      continue;
    }
    retryMs = 2000;
    ack.clear();
    next = monotonicMs() + cfg::CloudIntervalMs;
    JsonObject command = response["command"].as<JsonObject>();
    if (command.isNull())
      continue;
    const int channel = command["channel"] | 0;
    const char *id = command["requestId"] | "";
    // A late response must never turn into a fresh command after an outage.
    const uint64_t wall = static_cast<uint64_t>(time(nullptr)) * 1000;
    const uint64_t expiresAt = command["expiresAtMs"] | uint64_t(0);
    const uint64_t validFor = command["validForMs"] | uint64_t(0);
    uint64_t elapsed = monotonicMs() - started;
    if ((channel != 1 && channel != 2) || !strlen(id) || strlen(id) > 40 ||
        !command["state"].is<bool>() ||
        !command["expectedVersion"].is<uint32_t>() ||
        !command["bootId"].is<const char *>() || validFor > 10000 ||
        expiresAt <= wall || validFor <= elapsed)
      continue;
    JsonDocument input, result;
    for (const char *key : {"state", "expectedVersion", "bootId", "requestId"})
      input[key].set(command[key]);
    uint64_t remaining = min(validFor - elapsed, expiresAt - wall);
    int applied =
        executeRelay(channel, input, result, monotonicMs() + remaining);
    ack["requestId"] = String(id);
    ack["channel"] = channel;
    ack["status"] = applied;
    ack["result"].set(result.as<JsonVariant>());
    next = monotonicMs() + 100; // Return GPIO acknowledgement promptly.
  }
}

// ==================== app.cpp ====================
State state;
SemaphoreHandle_t stateMutex;
String isoTime() {
  time_t now = time(nullptr);
  if (now < 1700000000)
    return String();
  struct tm t;
  gmtime_r(&now, &t);
  char text[25];
  strftime(text, sizeof(text), "%Y-%m-%dT%H:%M:%SZ", &t);
  return String(text);
}
int localDay() {
  time_t now = time(nullptr);
  if (now < 1700000000)
    return 0;
  struct tm t;
  localtime_r(&now, &t);
  return (t.tm_year + 1900) * 10000 + (t.tm_mon + 1) * 100 + t.tm_mday;
}

void firmwareSetup() {
  stateMutex = xSemaphoreCreateMutex();
  configASSERT(stateMutex);
  snprintf(state.bootId, sizeof(state.bootId), "%08lx%08lx",
           static_cast<unsigned long>(esp_random()),
           static_cast<unsigned long>(esp_random()));
  relayBegin(); // Before Serial, flash, network or sensor initialization.
  Serial.begin(115200);
  storageBegin();
#if ESP_ARDUINO_VERSION_MAJOR >= 3
  esp_task_wdt_config_t watchdog{};
  watchdog.timeout_ms = 15000;
  watchdog.idle_core_mask = 0;
  watchdog.trigger_panic = true;
  if (esp_task_wdt_init(&watchdog) == ESP_ERR_INVALID_STATE)
    esp_task_wdt_reconfigure(&watchdog);
#else
  esp_task_wdt_init(15, true);
#endif
  esp_task_wdt_add(nullptr);
  configASSERT(xTaskCreatePinnedToCore(relayTask, "relay", 4096, nullptr, 3,
                                       nullptr, 1) == pdPASS);
  configASSERT(xTaskCreatePinnedToCore(sensorTask, "sensors", 6144, nullptr, 1,
                                       nullptr, 1) == pdPASS);
  configASSERT(xTaskCreatePinnedToCore(storageTask, "history", 6144, nullptr, 1,
                                       nullptr, 0) == pdPASS);
  networkBegin();
  apiBegin();
  configASSERT(xTaskCreatePinnedToCore(cloudTask, "cloud", 16384, nullptr, 1, nullptr, 0) == pdPASS);
  Serial.println("Home Assistant ESP32: spuštěno. Žádné přihlašovací údaje se "
                 "nevypisují.");
}
void firmwareLoop() {
  esp_task_wdt_reset();
  networkTick();
  apiTick();
  delay(2);
}

void setup() { firmwareSetup(); }
void loop() { firmwareLoop(); }
